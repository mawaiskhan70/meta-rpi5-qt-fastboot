## conf/layer.conf
```bitbake
# Layer registration file for meta-rpi5-qt-fastboot
# BitBake reads this file to discover and register this layer

# Tell BitBake where to find recipes in this layer
# BBPATH is the colon-separated search path BitBake uses
BBPATH .= ":${LAYERDIR}"

# Tell BitBake to look for .bb and .bbappend files recursively
# under this layer's directory
BBFILES += "${LAYERDIR}/recipes-*/*/*.bb \
            ${LAYERDIR}/recipes-*/*/*.bbappend"

# Layer compatibility — must match the Yocto release you are using
# "15" is the LAYERSERIES_COMPAT value for Scarthgap (5.0)
BBFILE_COLLECTIONS += "rpi5-qt-fastboot"
BBFILE_PATTERN_rpi5-qt-fastboot = "^${LAYERDIR}/"
BBFILE_PRIORITY_rpi5-qt-fastboot = "10"

LAYERDEPENDS_rpi5-qt-fastboot = " \
    core \
    raspberrypi \
    qt6-layer \
"

LAYERSERIES_COMPAT_rpi5-qt-fastboot = "scarthgap"
```
